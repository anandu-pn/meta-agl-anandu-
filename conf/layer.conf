## conf/layer.conf
```bitbake
# Layer configuration for meta-agl-anandu-
# AGL GSoC 2026 Quiz — Custom Yocto Layer

# We have a conf and classes directory, add to BBPATH
BBPATH .= ":${LAYERDIR}"

# We have recipes-* directories, add to BBFILES
BBFILES += " \
    ${LAYERDIR}/recipes-*/*/*.bb \
    ${LAYERDIR}/recipes-*/*/*.bbappend \
"

BBFILE_COLLECTIONS += "agl-anandu"
BBFILE_PATTERN_agl-anandu = "^${LAYERDIR}/"
BBFILE_PRIORITY_agl-anandu = "90"

LAYERDEPENDS_agl-anandu = "core meta-flutter"
LAYERSERIES_COMPAT_agl-anandu = "scarthgap styhead"
```
